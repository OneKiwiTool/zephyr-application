## boards/xtensa/esp32s3_devkit_n8r8/Kconfig.board
```kconfig
# XIAO ESP32S3 board configuration

# Copyright (c) 2023 Seeed Studio inc.
# SPDX-License-Identifier: Apache-2.0

config BOARD_ESP32S3_DEVKIT_N8R8
	bool "ESP32S3 DEVKIT N8R8 Board"
	depends on SOC_ESP32S3
```

## boards/xtensa/esp32s3_devkit_n8r8/Kconfig.defconfig
```kconfig
# Copyright (c) 2023 Seeed Studio inc.
# SPDX-License-Identifier: Apache-2.0

config BOARD
	default "esp32s3_devkit_n8r8"
	depends on BOARD_ESP32S3_DEVKIT_N8R8

config ENTROPY_GENERATOR
	default y

config HEAP_MEM_POOL_SIZE
	default 98304 if WIFI
	default 40960 if BT
	default 4096

choice BT_HCI_BUS_TYPE
	default BT_ESP32 if BT
endchoice
```
